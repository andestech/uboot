## arch/riscv/cpu/ax25/Kconfig
```kconfig
config RISCV_NDS
	bool
	imply CPU
	imply CPU_RISCV
	imply RISCV_TIMER
	imply NDS_PLIC if RISCV_MMODE
	help
	  Run U-Boot on AndeStar V5 platforms and use some specific features
	  which are provided by Andes Technology AndeStar V5 families.

if RISCV_NDS

config RISCV_NDS_CACHE
	bool "AndeStar V5 families specific cache support"
	help
	  Provide Andes Technology AndeStar V5 families specific cache support.

config SMP
	bool "SMP support"
	help
	  Provide SMP support.

endif
```
